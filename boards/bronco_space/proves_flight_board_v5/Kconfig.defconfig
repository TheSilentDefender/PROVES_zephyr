## boards/bronco_space/proves_flight_board_v5/Kconfig.defconfig
```kconfig
# Copyright (c) 2024 Andrew Featherstone
# SPDX-License-Identifier: Apache-2.0

if BOARD_PROVES_FLIGHT_BOARD_V5

config USB_SELF_POWERED
	default n

endif # BOARD_RPI_PICO2
```

## lib/power/Kconfig
```kconfig
config POWER
	bool "Support for on board power metering"
	help
	  This option enables the radios on board
	depends on I2C && SENSOR && ZBUS
```

## lib/radio/Kconfig
```kconfig
config RADIO
	bool "Support for radios"
	help
	  This option enables the radios on board
	depends on ZBUS && LORA && SPI
```

## lib/rtc/Kconfig
```kconfig
config RTC_LIB
	bool "Support for on board RV3028 RTC"
	help
	  This option enables the radios on board
	depends on I2C && RTC_RV3028
```

## lib/sensors/Kconfig
```kconfig
config SENSORS
	bool "Support for sensors"
	help
	  This option enables the sensors on board
	depends on ZBUS && SENSOR
```
