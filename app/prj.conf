## CMakeLists.txt
```
#-------------------------------------------------------------------------------
# PROVES FLIGHT SOFTWARE
#
# Copyright (c) 2021 Nordic Semiconductor ASA
# SPDX-License-Identifier: Apache-2.0

cmake_minimum_required(VERSION 3.13.1)
find_package(Zephyr REQUIRED HINTS $ENV{ZEPHYR_BASE})

project(app LANGUAGES C)

target_sources(app PRIVATE src/main.c)
```

## sample.yaml
```
sample:
  description: Flight Software for PROVES Flight Boards
  name: flight_software

common:
  build_only: true
  integration_platforms:
    - proves_flight_board_v5/rp2350a/m33

tests:
  app.default: {}
```

## prj.conf
```kconfig
# Interfaces
CONFIG_I2C=y
CONFIG_SPI=y

# Sensors
CONFIG_SENSOR=y
CONFIG_LSM6DSO=y
CONFIG_LSM6DSO_ENABLE_TEMP=y
CONFIG_LIS2MDL=y
CONFIG_INA219=y

# Zbus
CONFIG_ZBUS=y
CONFIG_ZBUS_CHANNEL_NAME=y
CONFIG_ZBUS_OBSERVER_NAME=y
CONFIG_ZBUS_MSG_SUBSCRIBER=y
CONFIG_ZBUS_LOG_LEVEL_DBG=n
CONFIG_ZBUS_LOG_LEVEL_INF=y

# Lora
CONFIG_LORA=y
CONFIG_LORA_SX127X=y

# RTC
CONFIG_RTC=y
CONFIG_RTC_RV3028=y

# Logging
CONFIG_LOG=y
CONFIG_LOG_DEFAULT_LEVEL=3
# Compiler settings
CONFIG_CBPRINTF_FP_SUPPORT=y

# Library
CONFIG_SENSORS=y
CONFIG_RADIO=y
CONFIG_RTC_LIB=y
CONFIG_POWER=y
```

## src/main.c
```c
/*
 * Copyright (c) 2021 Nordic Semiconductor ASA
 * SPDX-License-Identifier: Apache-2.0
 */

#include <time.h>
#include <zephyr/kernel.h>
#include <zephyr/drivers/sensor.h>
#include <zephyr/logging/log.h>
#include <zephyr/usb/usb_device.h>
#include <app/lib/sensors.h>
#include <app/lib/radio.h>
#include <app/lib/rtc.h>
#include <app/lib/power.h>

LOG_MODULE_REGISTER(main, CONFIG_APP_LOG_LEVEL);
static const struct device *usb_device;

ZBUS_CHAN_DECLARE(sensor_data_chan);
ZBUS_CHAN_DECLARE(power_data_chan);

int get_sensor_data(struct sensor_data *data_out) {
    struct sensor_data data;

    const int ret = zbus_chan_read(&sensor_data_chan, &data, K_MSEC(500));
    if (ret == 0) {
        memcpy(data_out, &data, sizeof(struct sensor_data));
        return 0;
    }

    LOG_WRN("Failed to read sensor data from Zbus: %d", ret);
    return ret;
}

int get_power_data(struct power_data *data_out) {
    struct power_data data;

    const int ret = zbus_chan_read(&power_data_chan, &data, K_MSEC(500));
    if (ret == 0) {
        memcpy(data_out, &data, sizeof(struct power_data));
        return 0;
    }

    LOG_WRN("Failed to read power data from Zbus: %d", ret);
    return ret;
}

int main(void) {
    usb_device = DEVICE_DT_GET(DT_CHOSEN(zephyr_console));

    if (usb_enable(NULL) != 0) {
        LOG_ERR("Failed to enable USB\n");
        return -1;
    }

    LOG_INF("USB Serial Initialized\n");

    if (sensor_manager_start() != 0) {
        LOG_ERR("Failed to start sensor manager\n");
        return -1;
    }

    if (lora_radio_start() != 0) {
        LOG_ERR("Failed to start LoRa radio\n");
        return -1;
    }

    if (rtc_init() != 0) {
        LOG_ERR("Failed to initialize RTC\n");
        return -1;
    }

    if (power_manager_start() != 0) {
        LOG_ERR("Failed to start power manager\n");
        return -1;
    }

    struct sensor_data sensor_reading;
    struct rtc_time current_time;
    struct power_data power_reading;
    while (1) {
        if (get_sensor_data(&sensor_reading) == 0) {
            LOG_INF("Temp: %.1f°C, Accel Z: %.2f",
                    (double) sensor_reading.temp, (double) sensor_reading.accel_z);
            lora_radio_send((uint8_t *) &sensor_reading, sizeof(sensor_reading));
        }
        get_rtc(&current_time);
        if (get_power_data(&power_reading) == 0) {
            LOG_INF("Voltage: %.2fV, Current: %.2fA, Power: %.2fW",
                    (double)power_reading.voltage, (double)power_reading.current, (double)power_reading.power);
        } else {
            LOG_ERR("Failed to read power data");
        }
        LOG_INF("Current RTC time: %04d-%02d-%02d %02d:%02d:%02d",
                current_time.tm_year + 1900, current_time.tm_mon + 1,
                current_time.tm_mday, current_time.tm_hour,
                current_time.tm_min, current_time.tm_sec);
        k_sleep(K_SECONDS(3));
    }

    return 0;
}
```
